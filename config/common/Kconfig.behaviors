## config/common/Kconfig.behaviors
```kconfig
config ZMK_BEHAVIOR_RAW_DRAG_SCROLL
    bool
    default y
    depends on DT_HAS_ZMK_BEHAVIOR_RAW_DRAG_SCROLL_ENABLED
    depends on RAW_HID

config ZMK_BEHAVIOR_AUTO_MOUSE_LAYER
    bool
    default y
    depends on DT_HAS_ZMK_BEHAVIOR_AUTO_MOUSE_LAYER_ENABLED
    depends on RAW_HID
    depends on ZMK_HID_INDICATORS

config ZMK_BEHAVIOR_AUTO_MOUSE_LAYER_TIMEOUT_MS
    int "AutoMouseLayer timeout"
    # Longer default is useful for debugging.
    default 700
    depends on ZMK_BEHAVIOR_AUTO_MOUSE_LAYER
    help
      Time in milliseconds after the last Ploopy AutoMouseLayer notification
      before the automatically activated Mouse layer is released.
```

## config/common/dts/bindings/behaviors/zmk,behavior-auto-mouse-layer.yaml
```yaml
description: Ploopy AutoMouseLayer configuration
compatible: "zmk,behavior-auto-mouse-layer"
properties:
  mac-base-layer:
    type: int
    required: true
  mac-mouse-layer:
    type: int
    required: true
  windows-base-layer:
    type: int
    required: true
  windows-mouse-layer:
    type: int
    required: true
```

## config/common/dts/bindings/behaviors/zmk,behavior-hold-mouse-layer.yaml
```yaml
description: Manually held mouse-layer request coordinated with automatic activation
compatible: "zmk,behavior-hold-mouse-layer"
include: zero_param.yaml

properties:
  mouse-layer:
    type: int
    required: true
```

## config/common/dts/bindings/behaviors/zmk,behavior-kp-or-hold-mouse-layer.yaml
```yaml
description: OS-specific tap-key / momentary mouse-layer hold-tap wrapper
compatible: "zmk,behavior-kp-or-hold-mouse-layer"
include: one_param.yaml

properties:
  hold-tap-behavior:
    type: phandle
    required: true
```

## config/common/dts/bindings/behaviors/zmk,behavior-kp-or-latch-mouse-layer.yaml
```yaml
description: OS-specific tap-key / latched mouse-layer hold-tap wrapper
compatible: "zmk,behavior-kp-or-latch-mouse-layer"
include: one_param.yaml

properties:
  hold-tap-behavior:
    type: phandle
    required: true
```

## config/common/dts/bindings/behaviors/zmk,behavior-latch-mouse-layer.yaml
```yaml
description: Persistent manual mouse-layer request set by the hold action
compatible: "zmk,behavior-latch-mouse-layer"
include: zero_param.yaml

properties:
  mouse-layer:
    type: int
    required: true
```

## config/common/dts/bindings/behaviors/zmk,behavior-manual-mouse-layer-latch.yaml
```yaml
description: Persistent manual mouse-layer request set by the hold action
compatible: "zmk,behavior-manual-mouse-layer-latch"
include: one_param.yaml
```

## config/common/dts/bindings/behaviors/zmk,behavior-manual-mouse-layer.yaml
```yaml
description: Manually held mouse-layer request coordinated with automatic activation
compatible: "zmk,behavior-manual-mouse-layer"
include: one_param.yaml
```

## config/common/dts/bindings/behaviors/zmk,behavior-raw-drag-scroll.yaml
```yaml
description: Raw HID drag scroll
compatible: "zmk,behavior-raw-drag-scroll"
include: zero_param.yaml
```

## config/common/dts/bindings/behaviors/zmk,behavior-raw-temporary-dpi.yaml
```yaml
description: Raw HID or Windows Num Lock temporary DPI signal
compatible: "zmk,behavior-raw-temporary-dpi"
properties:
  windows-host:
    type: boolean
    description: Use a Num Lock pulse instead of Raw HID signaling.
include: zero_param.yaml
```

## config/common/dts/bindings/behaviors/zmk,behavior-unlatch-mouse-layer.yaml
```yaml
description: Clear the manual mouse-layer request and return control to the layer controller
compatible: "zmk,behavior-unlatch-mouse-layer"
include: zero_param.yaml

properties:
  mouse-layer:
    type: int
    required: true
  base-layer:
    type: int
    required: true
```

## config/west.yml
```yaml
manifest:
  remotes:
    - name: zmkfirmware
      url-base: https://github.com/zmkfirmware
    - name: magagne
      url-base: https://github.com/magagne
    - name: zzeneg
      url-base: https://github.com/zzeneg
    - name: bildermankawasaki
      url-base: https://github.com/bildermankawasaki

  projects:
    - name: zmk
      remote: magagne
      revision: edf5c0814fd3ea202e43aad2d68fd32e882a518c
      import: app/west.yml

    - name: zmk-raw-hid
      remote: zzeneg
      revision: main

    - name: zmk-keyboard-totem
      remote: bildermankawasaki
      revision: main

  self:
    path: config
```
